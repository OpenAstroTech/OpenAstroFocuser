## lib/moonlite/Kconfig
```kconfig
# SPDX-License-Identifier: Apache-2.0

config MOONLITE
	bool "Moonlite serial protocol helpers"
	default n
	help
	  Enable the Moonlite focuser serial protocol helper library, which
	  provides the command parser, command enumeration, and handler interface
	  used by the focuser firmware implementation.
```

## tests/app/focuser/testcase.yaml
```yaml
common:
  tags: focuser
  platform_allow: qemu_cortex_m0
  integration_platforms:
    - qemu_cortex_m0
tests:
  app.focuser: {}
```

## tests/lib/moonlite/testcase.yaml
```yaml
common:
  tags: moonlite
  platform_allow: qemu_cortex_m0
  integration_platforms:
    - qemu_cortex_m0
tests:
  lib.moonlite: {}
```

## west.yml
```yaml
# Copyright (c) 2021 Nordic Semiconductor ASA
# SPDX-License-Identifier: Apache-2.0

manifest:
  self:
    west-commands: scripts/west-commands.yml

  remotes:
    - name: jilaypandya
      url-base: https://github.com/jilaypandya
    - name: zephyrproject-rtos
      url-base: https://github.com/zephyrproject-rtos

  projects:
    - name: zephyr
      remote: jilaypandya
      revision: feature/introduce-step-dir-functions
      import:
        # By using name-allowlist we can clone only the modules that are
        # strictly needed by the application.
        name-allowlist:
          - cmsis_6    # required by the ARM port for Cortex-M
          - hal_nordic # required by the custom_plank board (Nordic based)
          - hal_stm32  # required by the nucleo_f302r8 board (STM32 based)
          - hal_espressif # required by the esp32_devkitc_procpu board (Espressif based)
```
